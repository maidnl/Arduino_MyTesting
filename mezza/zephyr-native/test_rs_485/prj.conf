## CMakeLists.txt
```
# SPDX-License-Identifier: Apache-2.0

cmake_minimum_required(VERSION 3.20.0)

# get value of NORMALIZED_BOARD_TARGET early
find_package(Zephyr REQUIRED HINTS $ENV{ZEPHYR_BASE} COMPONENTS yaml boards)

set(DTC_OVERLAY_FILE ${CMAKE_CURRENT_LIST_DIR}/../../variants/${NORMALIZED_BOARD_TARGET}/${NORMALIZED_BOARD_TARGET}.overlay)

find_package(Zephyr REQUIRED HINTS $ENV{ZEPHYR_BASE})
project(test_rs_485)

target_include_directories(app 
    PUBLIC 
        ${CMAKE_CURRENT_SOURCE_DIR}/../../../../Arduino/libraries/ArduinoRS485/src
)

target_sources(app PRIVATE src/main.cpp
    ${CMAKE_CURRENT_SOURCE_DIR}/../../../../Arduino/libraries/ArduinoRS485/src/RS485.cpp)

zephyr_compile_options(-Wno-unused-variable -Wno-comment)
```

## prj.conf
```kconfig
CONFIG_GPIO=y
CONFIG_ARDUINO_API=y
CONFIG_FAT_FILESYSTEM_ELM=y
CONFIG_SPI=y
```

## src/main.cpp
```c
/*
 * SPDX-License-Identifier: Apache-2.0
 */

/* Blink inbuilt LED example */

#include <zephyr/kernel.h>
#include <zephyr/device.h>
#include <zephyr/storage/disk_access.h>
#include <zephyr/drivers/clock_control/stm32_clock_control.h>
#include <stm32_ll_rcc.h>
#include <zephyr/logging/log.h>
#include <Arduino.h>
#include "ArduinoRS485.h"

#define LED_BUILTIN D4

#define SLEEP_TIME_MS 1000

LOG_MODULE_REGISTER(test_rs_485, LOG_LEVEL_INF);

void blink_led() {
	static bool st = true;
	if (st) {
		st = false;
		digitalWrite(LED_BUILTIN, LOW);
	} else {
		st = true;
		digitalWrite(LED_BUILTIN, HIGH);
	}
}

int counter = 0;

void rs_485_tx() {
	printk("A\n");
	RS485.beginTransmission();
	printk("B\n");
	RS485.print("hello ");
	printk("C\n");
	RS485.println(counter);
	printk("D\n");
	RS485.endTransmission();
	printk("E\n");

	counter++;
}

void setup() {
}

void loop() {
	blink_led();
	rs_485_tx();
	delay(SLEEP_TIME_MS);
}
```
